## meta-raspi3b64dev/conf/layer.conf
```bitbake
# We have a conf and classes directory, add to BBPATH
BBPATH .= ":${LAYERDIR}"

# We have recipes-* directories, add to BBFILES
BBFILES += "${LAYERDIR}/recipes-*/*/*.bb \
            ${LAYERDIR}/recipes-*/*/*.bbappend"

BBFILE_COLLECTIONS += "meta-raspi3b64dev"
BBFILE_PATTERN_meta-raspi3b64dev = "^${LAYERDIR}/"
BBFILE_PRIORITY_meta-raspi3b64dev = "6"

LAYERDEPENDS_meta-raspi3b64dev = "core"
LAYERSERIES_COMPAT_meta-raspi3b64dev = "kirkstone"
```
